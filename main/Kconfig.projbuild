## sdkconfig.defaults
```kconfig
CONFIG_IDF_TARGET="esp32s3"
CONFIG_ESPTOOLPY_FLASHSIZE_16MB=y
CONFIG_ESPTOOLPY_FLASHMODE_QIO=y
CONFIG_ESP_DEFAULT_CPU_FREQ_MHZ_240=y
CONFIG_SPIRAM=y
CONFIG_SPIRAM_MODE_OCT=y
CONFIG_SPIRAM_SPEED_80M=y
CONFIG_SPIRAM_USE_CAPS_ALLOC=y
CONFIG_SPIRAM_TRY_ALLOCATE_WIFI_LWIP=y
CONFIG_ESP_CONSOLE_USB_SERIAL_JTAG=y
CONFIG_PARTITION_TABLE_CUSTOM=y
CONFIG_PARTITION_TABLE_CUSTOM_FILENAME="partitions.csv"
CONFIG_BOOTLOADER_APP_ROLLBACK_ENABLE=y
CONFIG_BOOTLOADER_APP_ANTI_ROLLBACK=y
CONFIG_BOOTLOADER_APP_SECURE_VERSION=1
CONFIG_MBEDTLS_CERTIFICATE_BUNDLE=y
# CONFIG_ESP_TLS_SERVER_SESSION_TICKETS is not set
# CONFIG_ZV_M0_ACCEPTANCE_MODE is not set
# CONFIG_ZV_M1_ACCEPTANCE_MODE is not set
# CONFIG_ZV_UI_ACCEPTANCE_MODE is not set
# CONFIG_ZV_UI_SHELL_MODE is not set
# CONFIG_ZV_M1_SOAK_MODE is not set
# CONFIG_ZV_M2_PROVISION_MODE is not set
# CONFIG_ZV_M2_WSS_MODE is not set
# CONFIG_ZV_M2_LINK_SOAK_MODE is not set
# CONFIG_ZV_M3_APPROVAL_MODE is not set
# CONFIG_ZV_M4_OTA_MODE is not set
```
